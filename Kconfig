## Kconfig
```kconfig
# -------------------------------------
# Copyright 2026 NXP
# SPDX-License-Identifier: BSD-3-Clause
# -------------------------------------

menu "SGI PKC - PQC Addon"

config MCUX_COMPONENT_component.sgi_pkc_pqc
    bool "SGI PKC - PQC Addon"
	# This is just addon for sgi_pkc component
    select MCUX_COMPONENT_component.sgi_pkc
    select MCUX_COMPONENT_component.sgi_pkc_pqc.mldsa
    select MCUX_COMPONENT_component.sgi_pkc_pqc.mlkem
	
	if MCUX_COMPONENT_component.sgi_pkc_pqc
	  choice
	    prompt "Target device family - Platform Support"

		config MCUX_COMPONENT_component.sgi_pkc_pqc.platform_pqc.mcxa2xx
            bool "MCXA"
			depends on is_device.MCXA

		config MCUX_COMPONENT_component.sgi_pkc_pqc.platform_pqc.mcxa5xx
            bool "MCXA5"
			depends on is_device.MCXA5XX

		config MCUX_COMPONENT_component.sgi_pkc_pqc.platform_pqc.mcxl2xx
            bool "MCXL"
			depends on is_device.MCXL

		config MCUX_COMPONENT_component.sgi_pkc_pqc.platform_pqc.mcxw7x
            bool "MCXW"
			depends on is_device.MCXW7X
	  endchoice
	endif

    menu "Documentation"

        config MCUX_COMPONENT_component.sgi_pkc_pqc.doc.mcxa2xx
            bool "MCXA2"
			depends on is_device.MCXA

        config MCUX_COMPONENT_component.sgi_pkc_pqc.doc.mcxa5xx
            bool "MCXA5"
			depends on is_device.MCXA5XX

        config MCUX_COMPONENT_component.sgi_pkc_pqc.doc.mcxl2xx
            bool "MCXL"
			depends on is_device.MCXL

		config MCUX_COMPONENT_component.sgi_pkc_pqc.doc.mcxw7x
            bool "MCXW"
			depends on is_device.MCXW7X
	  
    endmenu

    menu "Cryptographic Modules"
        config MCUX_COMPONENT_component.sgi_pkc_pqc.kem
            bool "Kem"
            select MCUX_COMPONENT_component.sgi_pkc.xof_modes

        config MCUX_COMPONENT_component.sgi_pkc_pqc.mldsa
            bool "MlDsa"

        config MCUX_COMPONENT_component.sgi_pkc_pqc.mlkem
            bool "MlKem"
            select MCUX_COMPONENT_component.sgi_pkc_pqc.kem

    endmenu

    menu "Examples"
        config MCUX_COMPONENT_component.sgi_pkc_pqc.examples
            bool "Examples"
            select MCUX_COMPONENT_component.sgi_pkc.example
            select MCUX_COMPONENT_component.sgi_pkc_pqc.examples_mldsa
            select MCUX_COMPONENT_component.sgi_pkc_pqc.examples_mlkem

        config MCUX_COMPONENT_component.sgi_pkc_pqc.examples_mldsa
            bool "MlDsa examples"
            select MCUX_COMPONENT_component.sgi_pkc_pqc.mldsa

        config MCUX_COMPONENT_component.sgi_pkc_pqc.examples_mlkem
            bool "MlKem examples"
            select MCUX_COMPONENT_component.sgi_pkc_pqc.mlkem
    endmenu
endmenu
```
